#include <Arduino_FreeRTOS.h>
 #include<semphr.h>  
 #define redLed 7  
 #define greenLed 8 

 //--------Ultra sonic ranging system decleration--------------------
 const int trigPin = 9;
 const int ecoPin = 10;
//variable dec
 long duration;
 int distanceCm;
 //---------Change detection using derativitive decleraton--------------
 long arr[4]={0,0,0,0};
 long velo[4] = {0,0,0,0};
 long newData = 0;
 long derv;
 //---------Take picture---------------------------------------
 int takepic = 0;
 const int picPin = 2;
 //---------function decleration---------------------------------------
 int Deravitive(void){
  return (arr[0]+3*arr[1]-3*arr[2]-arr[3])/18;
 }
 int midDerivitive(void){
  return (velo[0]+3*velo[1]-3*velo[2]-velo[3])/3;
 }
 void mid_pur(int in){
  velo[3] = velo[2];
  velo[2] = velo[1];
  velo[1] = velo[0];
  velo[0] = in;
 }
 void MACQ_Put(int in){
  arr[3] = arr[2];
  arr[2] = arr[1];
  arr[1] = arr[0];
  arr[0] = in;
 }
 //---------Semaphore decleration--------------------------------------
 static SemaphoreHandle_t busy_Semaphore; //changed detected semaphore give
                                    //actiond due to change detected Semaphore take
 static SemaphoreHandle_t pic_Taken_Semaphore; //Picture need to be taken semaphore give
                                               //Picture taken DONE semaphore take
 static SemaphoreHandle_t new_Data_Semaphore; //New data generated by untra sonic system would give semaphore
                                              //the change detection task would take the semaphore
 TaskHandle_t ultraTask_handle = NULL;
 TaskHandle_t derviTask_handle = NULL;
 TaskHandle_t picTask_handle = NULL;
 
 void setup() {  
  Serial. begin(9600);
  busy_Semaphore = xSemaphoreCreateMutex();
  pic_Taken_Semaphore = xSemaphoreCreateMutex();
  new_Data_Semaphore = xSemaphoreCreateMutex();
  xTaskCreate(ultraRangeTask, "Untra range Task", 128, NULL, 1, &ultraTask_handle); 
  xTaskCreate(changeDetectTask, "Detect any change Task", 128, NULL, 1, &derviTask_handle);  
  xTaskCreate(takePicTask, "Takes a picture Task", 128, NULL, 2, &picTask_handle);  
 }  
 
 void loop() {}  
 
 void ultraRangeTask(void *pvParameters){  
  pinMode(redLed, OUTPUT); 
  pinMode(trigPin, OUTPUT);
  pinMode(ecoPin, INPUT);
  while(1){  
   //Serial.print("Ultrasonic ranging system engage.\n");
   vTaskSuspend(derviTask_handle);
   digitalWrite(trigPin, LOW);
   delayMicroseconds(2);
   digitalWrite(trigPin, HIGH);
   delayMicroseconds(10);
   digitalWrite(trigPin, LOW);
   duration = pulseIn(ecoPin, HIGH);
   distanceCm= duration*0.034/2;
   Serial.print("Distance CM:");
    Serial.println(distanceCm);
   //distanceInch = duration*0.0133/2;

      newData = distanceCm;
      vTaskResume(derviTask_handle);
   
  } 
 }  
  void changeDetectTask(void *pvParameters){  
  pinMode(greenLed, OUTPUT);  
  while(1){  
     vTaskSuspend(ultraTask_handle);
      //mid_pur(newData); // shift the new data in the array
      //MACQ_Put(midDerivitive());  // puting the first derivitive in the final array
      MACQ_Put(newData);  // putting the new data in the final array
                          // as there would no longer use of 2nd derivitive
      derv = abs(Deravitive()); // getting the abs of the drivitinve of the final array
       Serial.print("dV/dt: ");
       Serial.println(derv);
//      Serial.print("newData: ");
//      Serial.println(newData);
      if(derv > 100){
          
        takepic = 1;
        vTaskResume(picTask_handle);
        Serial.println("changedetecttask -> derv > 100");
       }
       else
        takepic = 0;

      xSemaphoreGive(new_Data_Semaphore);
    vTaskResume(ultraTask_handle);
  }  
 }
 
  void takePicTask(void *pvParameters){    
  pinMode(picPin, OUTPUT);
        const TickType_t xDelay = 1000 / portTICK_PERIOD_MS; 
        const TickType_t xDelay2 = 1000 / portTICK_PERIOD_MS; 
  while(1){  
      Serial.print("taking piture\n");
        
      if(takepic == 1){
       digitalWrite(picPin, HIGH);
        Serial.print("picture Taken\n");
        Serial.print("picture Taken\n");
        Serial.print("picture Taken\n");
        Serial.print("picture Taken\n");
        Serial.print("picture Taken\n");
        takepic = 0;
        vTaskDelay(xDelay);
        digitalWrite(picPin, LOW);
        vTaskDelay(xDelay2);
      }
      else
     Serial.print("picture Not Taken\n");
     vTaskSuspend(picTask_handle);
  }  
 }
 
